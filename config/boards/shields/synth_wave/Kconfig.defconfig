## config/boards/shields/synth_wave/Kconfig.defconfig
```kconfig
# Copyright (c) 2023 ZMK
# SPDX-License-Identifier: MIT

if SHIELD_SYNTH_WAVE_LEFT

	config ZMK_KEYBOARD_NAME
		default "Synth Wave"

	config ZMK_SPLIT_ROLE_CENTRAL
		default y
endif

if SHIELD_SYNTH_WAVE_LEFT || SHIELD_SYNTH_WAVE_RIGHT

	config ZMK_SPLIT
		default y

	config ZMK_DISPLAY
		select LVGL_USE_CONT
		select LVGL_FONT_MONTSERRAT_12
		select LVGL_USE_LABEL
		select LV_USE_IMG
	if ZMK_DISPLAY
		config I2C
			default y

		config SSD1306
			default y

		config SSD1306_REVERSE_MODE
			default y
	endif

	choice ZMK_DISPLAY_STATUS_SCREEN
		default ZMK_DISPLAY_STATUS_SCREEN_CUSTOM
	endchoice

	choice ZMK_DISPLAY_STATUS_SCREEN
		default ZMK_DISPLAY_STATUS_SCREEN_CUSTOM
	endchoice

	menuconfig CUSTOM_WIDGET_BATTERY_STATUS
		bool "custom battery status widget"

	menuconfig CUSTOM_WIDGET_OUTPUT_STATUS
		bool "custom output status widget"

	menuconfig CUSTOM_WIDGET_LAYER_STATUS
		bool "custom layer status widget"

	menuconfig CUSTOM_WIDGET_PERIPHERAL_STATUS
		bool "custom peripheral status widget"

endif
```

## config/boards/shields/synth_wave/Kconfig.shield
```kconfig
# Copyright (c) 2023 ZMK
# SPDX-License-Identifier: MIT

config SHIELD_SYNTH_WAVE_LEFT
	def_bool $(shields_list_contains,synth_wave_left)

config SHIELD_SYNTH_WAVE_RIGHT
	def_bool $(shields_list_contains,synth_wave_right)
```

## config/west.yml
```yaml
# manifest:
#   remotes:
#     - name: zmkfirmware
#       url-base: https://github.com/zmkfirmware
#   projects:
#     - name: zmk
#       remote: zmkfirmware
#       revision: main
#       import: app/west.yml
#   self:
#     path: config
manifest:
  remotes:
    - name: luerl21
      url-base: https://github.com/luerl21
  projects:
    - name: zmk
      remote: luerl21
      revision: main
      import: app/west.yml
  self:
    path: config
```

## west.yml
```yaml
manifest:
  remotes:
    - name: zmkfirmware
      url-base: https://github.com/zmkfirmware
    - name: petejohanson
      url-base: https://github.com/petejohanson
  projects:
    - name: zmk
      remote: petejohanson
      revision: features/soft-off-take-3
      import: app/west.yml
  self:
    path: config
```
